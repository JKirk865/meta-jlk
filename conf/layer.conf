## conf/layer.conf
```bitbake
# We have a conf and classes directory, add to BBPATH
BBPATH .= ":${LAYERDIR}"

# We have recipes-* directories, add to BBFILES
BBFILES += "${LAYERDIR}/recipes-*/*/*.bb \
            ${LAYERDIR}/recipes-*/*/*.bbappend"

BBFILE_COLLECTIONS += "meta-jlk"
BBFILE_PATTERN_meta-jlk = "^${LAYERDIR}/"
BBFILE_PRIORITY_meta-jlk = "6"

LAYERDEPENDS_meta-jlk = "core"
LAYERSERIES_COMPAT_meta-jlk = "dunfell"
```
